## conf/layer.conf
```bitbake
# We have a conf and classes directory, add to BBPATH
BBPATH =. "${LAYERDIR}:"

BBFILES += "${LAYERDIR}/recipes-*/*/*.bb \
        ${LAYERDIR}/recipes-*/*/*.bbappend"

BBFILE_COLLECTIONS += "meta-openssl-one-zero-two-fips"
BBFILE_PATTERN_meta-openssl-one-zero-two-fips = "^${LAYERDIR}/"
BBFILE_PRIORITY_meta-openssl-one-zero-two-fips = "5"

LAYERVERSION_meta-openssl-one-zero-two-fips = "1"

LAYERSERIES_COMPAT_meta-openssl-one-zero-two-fips = "zeus"

LAYERPATH_meta-openssl-one-zero-two-fips = "${LAYERDIR}"

LAYERDEPENDS_meta-openssl-one-zero-two-fips = " \
        meta-openssl-one-zero-two \
"

IMAGE_CLASSES_append = "${@'' if d.getVar('OPENSSL_FIPS_ENABLED', True) != '1' else ' image-enable-fips'}"

LAYER_PATH_meta-openssl-one-zero-two-fips = "${LAYERDIR}"

KERNEL_CLASSES_append = " ${@bb.utils.contains('OPENSSL_FIPS_ENABLED', '1', ' fips_kernel', '',d)}"
```
